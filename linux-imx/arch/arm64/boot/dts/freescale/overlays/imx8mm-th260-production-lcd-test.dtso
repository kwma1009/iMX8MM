// SPDX-License-Identifier: GPL-2.0
/*
 * Copyright (C) 2022 PHYTEC Messtechnik GmbH
 * Author: Teresa Remmet <t.remmet@phytec.de>
 *
 * Set "phytec,production_dummy" display to test MIPI DSI interface
 * automaticlly with LVDStoParallel converter
 */

/dts-v1/;
/plugin/;

/ {
	compatible = "phytec,imx8mm-th260";
};

&display {
	compatible = "phytec,production_dummy";
};
